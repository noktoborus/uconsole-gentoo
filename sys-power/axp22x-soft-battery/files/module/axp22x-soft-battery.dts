// SPDX-License-Identifier: GPL-2.0
/*
 * The settings and the model of the module axp22x_soft_battery.
 *
 * The module has no default value. Each value below is required, but
 * charge-cv-table. A value that is missing or bad stops the module: there
 * is then no battery in the system.
 *
 * The values are in two nodes at the root. The module finds its node by
 * the compatible, not by a path, so this overlay is the same on each
 * device with an AXP22x. Put it in config.txt after the overlay of the
 * device:
 *
 *	dtoverlay=clockworkpi-uconsole-cm5
 *	dtoverlay=axp22x-soft-battery
 *
 * The overlay of `axp22x-soft-battery gen-dts` goes after this line. It
 * sets again the values the daemon learned. battery@0 of the overlay of
 * the device is not read.
 *
 * Parameters:
 *
 *	v_off	V_OFF, the voltage at which the PMIC cuts the power, in uV:
 *		voltage-min-design-microvolt of the cells. 2600000 to
 *		3300000 by 100000; not over end.
 *	end	the voltage of 0 % with no charger, in uV:
 *		axp22x-soft-battery,end-microvolt. From v_off to 3800000.
 *	energy_full_design_uwh
 *		the energy of the design of the cells, in uWh:
 *		energy-full-design-microwatt-hours of the cells. More than
 *		0. The name is the one of clockworkpi-custom-battery.
 *
 *	dtoverlay=axp22x-soft-battery,v_off=3000000,end=3250000
 *	dtparam=energy_full_design_uwh=33309000
 *
 * A line of config.txt is cut after 98 characters, with no warning. Put
 * a long list of parameters on lines of dtparam= after the dtoverlay=.
 */

/dts-v1/;
/plugin/;

/ {
	compatible = "brcm,bcm2835";

	fragment@0 {
		target-path = "/";
		__overlay__ {
			/* The node of the module. There must be one only. */
			axp22x_soft_battery: axp22x-soft-battery {
				compatible = "axp22x-soft-battery";
				/* The node of the cells, below. */
				monitored-battery = <&axp22x_soft_battery_cells>;

				/* The energy of a full charge, in uWh. More than 0. */
				axp22x-soft-battery,energy-full-microwatt-hours = <24790000>;
				/* At this voltage or under, with no charger, the level is
				 * 0 %. In uV, from voltage-min-design-microvolt to 3800000.
				 */
				axp22x-soft-battery,end-microvolt = <3200000>;
				/* The time between two samples, in ms. 1000 to 600000. */
				axp22x-soft-battery,sample-interval-ms = <10000>;
				/* After the charger comes or goes, and at the start, this
				 * count of samples comes at fast-interval-ms, then the
				 * period above. 0 to 100.
				 */
				axp22x-soft-battery,fast-samples = <5>;
				/* The time between two of those samples, in ms. 100 to
				 * 600000.
				 */
				axp22x-soft-battery,fast-interval-ms = <1000>;
				/* The charge is full when the charger stops and the voltage
				 * is at the target of the charge less this margin. In uV,
				 * 1 to 500000.
				 */
				axp22x-soft-battery,full-margin-microvolt = <50000>;
				/* Under this current of the charge, the module asks the
				 * PMIC if it still charges. In uA, 1 to 1000000.
				 */
				axp22x-soft-battery,full-current-microamp = <100000>;
				/* When the samples fail for this time, in ms, the AXP is
				 * silent: the values of the battery give an error until a
				 * sample works again. 1000 to 3600000.
				 */
				axp22x-soft-battery,silent-ms = <60000>;
				/* When the samples fail for this time, in ms, the module
				 * powers the system off. More than silent-ms, to 3600000.
				 */
				axp22x-soft-battery,guard-ms = <180000>;
				/* Optional: with this property the module does not power
				 * the system off at guard-ms; it writes a line only. Then,
				 * if the AXP22x is gone, nothing powers the system off: the
				 * cells may run down past the safe voltage.
				 *
				 * axp22x-soft-battery,no-hardware-protect;
				 */
				/* Optional: the curve of the charge while the voltage is at
				 * the target. Pairs <uA percent>, 1 to 16; the current
				 * falls, the percent rises, 0 to 100. With none, the curve
				 * of the discharge is used. gen-dts writes it.
				 *
				 * axp22x-soft-battery,charge-cv-table = <1310000 86>, ...;
				 */
				/* The writes of the registers at each start, in order:
				 * <reg mask value>, each 0x00 to 0xff, the value in the
				 * mask. These are the writes of axp20x_battery of Rex.
				 */
				axp22x-soft-battery,reg-writes =
					<0x30 0x03 0x03>,	/* VBUS: no current limit */
					<0x32 0x08 0x08>,	/* CHGLED by the charger */
					<0x34 0x30 0x20>,	/* the output on after the charge; CHGLED type A */
					<0x36 0x0f 0x0b>,	/* the power key: 10 s, off, no start again */
					<0x90 0x07 0x00>;	/* GPIO0: output low */
			};

			/* The cells: a simple-battery of the kernel. */
			axp22x_soft_battery_cells: axp22x-soft-battery-cells {
				compatible = "simple-battery";
				/* The chemistry of the cells. */
				device-chemistry = "lithium-ion";
				/* The current of the charge, in uA. 300000 to 2550000;
				 * between two steps of 150000 it is rounded down.
				 */
				constant-charge-current-max-microamp = <2100000>;
				/* The highest voltage of the design, in uV. */
				voltage-max-design-microvolt = <4200000>;
				/* V_OFF: the PMIC cuts the power at this voltage, in uV.
				 * 2600000 to 3300000; between two steps of 100000 it is
				 * rounded up.
				 */
				voltage-min-design-microvolt = <2900000>;
				/* The energy of the design, in uWh. More than 0. The
				 * health of the battery is the energy of the full charge
				 * of the node above over this one.
				 */
				energy-full-design-microwatt-hours = <24790000>;
				/* The target of the charge, in uV: 4100000, 4200000,
				 * 4220000 or 4240000; a value between them is rounded down.
				 */
				constant-charge-voltage-max-microvolt = <4200000>;
				/* The curve of the discharge: <uV percent>, the voltage
				 * falls point by point. The kernel reads the table only
				 * with its temperature. This is the mean of three logs to
				 * the silence of the AXP, by tools/make-curve.py with R
				 * 87 mOhm; the PMIC was at 24 C in the one log that has
				 * its temperature.
				 */
				ocv-capacity-celsius = <24>;
				ocv-capacity-table-0 =
					<4221000 100>, <4119000 95>, <4093000 90>, <4084000 85>,
					<4075000 80>, <4064000 75>, <4035000 70>, <3988000 65>,
					<3934000 60>, <3897000 55>, <3868000 50>, <3837000 45>,
					<3799000 40>, <3760000 35>, <3716000 30>, <3664000 25>,
					<3608000 20>, <3554000 15>, <3499000 10>, <3437000 5>,
					<3351000 0>;
				/* R of the cells, in micro-ohms: 10000 to 500000. The level
				 * takes OCV = V - I * R with this R; gen-dts writes it.
				 */
				factory-internal-resistance-micro-ohms = <87000>;
			};
		};
	};

	__overrides__ {
		v_off = <&axp22x_soft_battery_cells>,"voltage-min-design-microvolt:0";
		end = <&axp22x_soft_battery>,"axp22x-soft-battery,end-microvolt:0";
		energy_full_design_uwh = <&axp22x_soft_battery_cells>,"energy-full-design-microwatt-hours:0";
	};
};
